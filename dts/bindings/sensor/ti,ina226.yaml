## dts/bindings/sensor/ti,ina226.yaml
```yaml
#
# Copyright 2021 The Chromium OS Authors
# Copyright 2021 Grinn
#
# SPDX-License-Identifier: Apache-2.0
#

description: |
    TI INA226 Bidirectional Current and Power Monitor.
    The <include/dt-bindings/sensor/ina226.h> file should be included
    in the DeviceTree and it provides macro that can be used for
    initializing the configuration register.

compatible: "ti,ina226"

include: ti,ina23x226-common.yaml
```

## dts/bindings/sensor/ti,ina231.yaml
```yaml
#
# Copyright 2021 The Chromium OS Authors
# Copyright 2021 Grinn
#
# SPDX-License-Identifier: Apache-2.0
#

description: |
    TI INA231 Bidirectional Current and Power Monitor.
    The <include/dt-bindings/sensor/ina230.h> file should be included
    in the DeviceTree and it provides macro that can be used for
    initializing the configuration register.

compatible: "ti,ina231"

include: ti,ina23x226-common.yaml
```

## dts/bindings/sensor/ti,ina23x226-common.yaml
```yaml
#
# Copyright 2022 Whisper.AI
#
# SPDX-License-Identifier: Apache-2.0

# Common fields for TI INA 230, 231, and 226 Sensors

include: ti,ina23x-common.yaml

properties:
    mask:
      type: int
      required: false
      default: 0
      # default all alert sources to disabled
      description: Mask register, default matches the power-on reset value

    alert-limit:
      type: int
      required: false
      default: 0
      # default alert limit is 0V
      description: Alert register, default matches the power-on reset value

    irq-gpios:
      type: phandle-array
      required: false
      description: IRQ Alert pin
```
